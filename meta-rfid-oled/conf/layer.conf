## meta-rfid-oled/conf/layer.conf
```bitbake
# We have a conf and classes directory, add to BBPATH
BBPATH .= ":${LAYERDIR}"

# We have recipes-* directories, add to BBFILES
BBFILES += "${LAYERDIR}/recipes-*/*/*.bb \
            ${LAYERDIR}/recipes-*/*/*.bbappend"

BBFILE_COLLECTIONS += "meta-rfid-oled"
BBFILE_PATTERN_meta-rfid-oled = "^${LAYERDIR}/"
BBFILE_PRIORITY_meta-rfid-oled = "6"

LAYERDEPENDS_meta-rfid-oled = "core"
LAYERSERIES_COMPAT_meta-rfid-oled = "scarthgap nanbield mickledore kirkstone dunfell"

# Automatically enable I2C, SPI and overlay for RPi when this layer is included
ENABLE_I2C = "1"
ENABLE_SPI_BUS = "1"
RPI_EXTRA_CONFIG:append = " \n# Enable RFID RC522 Overlay\ndtoverlay=rc522\n"

# Autoload i2c-dev so /dev/i2c-1 is created automatically
KERNEL_MODULE_AUTOLOAD += "i2c-dev"
```
