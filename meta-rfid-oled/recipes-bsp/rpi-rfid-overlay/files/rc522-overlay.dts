/dts-v1/;
/plugin/;

/ {
    compatible = "brcm,bcm2711"; // Raspberry Pi 4

    fragment@0 {
        target = <&spi0>;
        __overlay__ {
            status = "okay";
            #address-cells = <1>;
            #size-cells = <0>;

            spidev@0 {
                status = "disabled";
            };

            rc522: rc522@0 {
                compatible = "nxp,rc522";
                reg = <0>; /* Chip Select 0 (CE0) */
                spi-max-frequency = <1000000>; /* 1 MHz */
                status = "okay";
            };
        };
    };
};
